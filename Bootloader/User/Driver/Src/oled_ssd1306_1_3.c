#include "oled_ssd1306_1_3.h"
#include "main.h"
#include <string.h>
#include <stdio.h>
#include "soft_i2c.h"
#include "uni_shell.h"

const uint8_t OLED_F8x16[][16]=
{
	{0x00,0x00,0x00,0x00,0x00,0x00,0x00,0x00,0x00,0x00,0x00,0x00,0x00,0x00,0x00,0x00},//  0(空)
	{0x00,0x00,0x00,0xF8,0x00,0x00,0x00,0x00,0x00,0x00,0x00,0x33,0x30,0x00,0x00,0x00},//! 1
	{0x00,0x10,0x0C,0x06,0x10,0x0C,0x06,0x00,0x00,0x00,0x00,0x00,0x00,0x00,0x00,0x00},//" 2
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	{0x00,0x06,0x01,0x01,0x02,0x02,0x04,0x04,0x00,0x00,0x00,0x00,0x00,0x00,0x00,0x00}//~ 94
};

uint8_t OLED_Init(void)
{
	uint8_t ret = 1;
	while (HAL_GetTick() < 1000);
#define CMD_WARP(__cmd__)	\
	if (OLED_Write_Command(__cmd__)) { \
		LOG_ERROR("OLED Init in write cmd 0x%X Error", __cmd__);				\
		ret = 1;					\
		goto end;					\
	}
	CMD_WARP(0xAE);				//close display
	CMD_WARP(0xD5);	//set display clock psc/frq
	CMD_WARP(0x80);

	CMD_WARP(0xA8);	//set multiplex
	CMD_WARP(0x3F);

	CMD_WARP(0xD3);	//set display offset
	CMD_WARP(0x00);

	CMD_WARP(0x40);  	//set display begin row

	CMD_WARP(0xA1);	//set left-right direction, 0xA1 normal, 0xA0 reverse
	CMD_WARP(0xC8);	//set top-bottom direction, 0xC8 normal, 0xC0 reverse

	CMD_WARP(0xDA);	//set com pin hardware config
	CMD_WARP(0x12);

	CMD_WARP(0x81);	//set contrast ratio
	CMD_WARP(0xCF);

	CMD_WARP(0xD9);	//set pre-charging period
	CMD_WARP(0xF1);

	CMD_WARP(0xDB);	//set VCOMH cancel select level
	CMD_WARP(0x30);

	CMD_WARP(0xA4);	//open display

	CMD_WARP(0xA6);	//set display normal

	CMD_WARP(0x8D);	//set charging pump
	CMD_WARP(0x14);

	CMD_WARP(0xAF);	//start display

	OLED_Clear();				//clear display
	ret = 0;
end:
	return ret; 
}

uint8_t OLED_Write_Command(uint8_t cmd)
{
	uint8_t ret = 1;
	IIC_Start();
	
	if (IIC_Send_Byte(OLED_DEVICE_ADDRESS)) {
		ret = 1;
		LOG_ERROR("OLED write command: send device address no ack back");
		goto end;
	}
	
	if (IIC_Send_Byte(0x00)) {
		ret = 1;
		LOG_ERROR("OLED write command: send 0x40 no ack back");
		goto end;
	}
	
	if (IIC_Send_Byte(cmd)) {
		ret = 1;
		LOG_ERROR("OLED write command: send cmd no ack back");
		goto end;
	}
	ret = 0;
end:
	IIC_Stop();
	return ret;
}

void OLED_Write_Data(uint8_t data)
{
	IIC_Start();
	IIC_Send_Byte(OLED_DEVICE_ADDRESS);
	IIC_Send_Byte(0x40);
	IIC_Send_Byte(data);
	IIC_Stop();
}

void OLED_Set_Cursor(uint8_t x, uint8_t y)
{
	OLED_Write_Command(0xB0 | y);
	OLED_Write_Command(0x10 | ((x & 0xF0) >> 4));
	OLED_Write_Command(0x02 | (x & 0x0F));
}

void OLED_Clear(void)
{
	for (int i = 0 ; i < 8 ; i++) {
		OLED_Set_Cursor(0, i);
		for (int j = 0 ; j < 128 ; j++) {
			OLED_Write_Data(0x00);
		}
	}
}

void OLED_Show_Char(uint8_t row, uint8_t column, char ch)
{
	OLED_Set_Cursor((row - 1) * 2, (column - 1) * 8);
	for (int i = 0 ; i < 8 ; i++) {
		OLED_Write_Data(OLED_F8x16[ch - ' '][i]);
	}
	OLED_Set_Cursor((row - 1) * 2 + 1, (column - 1) * 8);
	for (int i = 0 ; i < 8 ; i++) {
		OLED_Write_Data(OLED_F8x16[ch - ' '][i + 8]);
	}
}

void OLED_Show_String(uint8_t row, uint8_t column, const char* str)
{
	int len = strlen(str);
	for (int i = 0 ; i < len ; i++) {
		OLED_Show_Char(row, column + i, str[i]);
	}
}

void OLED_Show_Number(uint8_t row, uint8_t column, int32_t num)
{
	static char buffer[20] = {0};
	sprintf(buffer, "%d", num);
	OLED_Show_String(row, column, buffer);
}